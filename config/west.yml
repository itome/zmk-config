## config/west.yml
```yaml
manifest:
  remotes:
    - name: zmkfirmware
      url-base: https://github.com/itome
  projects:
    - name: zmk
      remote: zmkfirmware
      revision: charybdis
      import: app/west.yml
  self:
    path: config
```
